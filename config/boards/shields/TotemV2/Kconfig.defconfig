## config/boards/shields/TotemV2/Kconfig.defconfig
```kconfig
if SHIELD_TOTEMV2_LEFT

config ZMK_KEYBOARD_NAME
    default "TOTEM"
    
config ZMK_SPLIT_ROLE_CENTRAL
    default y

endif

if SHIELD_TOTEMV2_LEFT || SHIELD_TOTEMV2_RIGHT

config ZMK_SPLIT
    default y

endif
```

## config/boards/shields/TotemV2/Kconfig.shield
```kconfig
config SHIELD_TOTEMV2_LEFT
    def_bool $(shields_list_contains,TotemV2_left)

config SHIELD_TOTEMV2_RIGHT
    def_bool $(shields_list_contains,TotemV2_right)
```
